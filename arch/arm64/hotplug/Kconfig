## arch/arm64/hotplug/Kconfig
```kconfig
config INTELLI_PLUG
        bool "Enable intelli-plug cpu hotplug driver"
        default n
        help
          Generic Intelli-plug cpu hotplug driver for ARM SOCs	

config THUNDERPLUG_CONTROL
	bool "Enable plugging down/up of cores using powersuspend"
	default y
	help
	  This driver uses powersuspend to take down the cpu cores
	  on a octa core device.
```
